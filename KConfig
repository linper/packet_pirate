## KConfig
```kconfig
mainmenu "Packet pirate configurations"

source "src/filters/KConfig"
source "src/dump/KConfig"
source "scripts/def_KConfig"
source "scripts/devel_KConfig"
source "scripts/tests_KConfig"
    
choice VERBOSITY
prompt "Logging"
default VERB_WARN
help
Message logging will be enabled. If unchecked - will not be compiled in filal binary. Othervise may decrease performance

config DFN_VERB_QUIET
bool "Quiet"
help
	"No messages"

config DFN_VERB_CRIT
bool "Critical"
help
	"Logs only critical messages"

config DFN_VERB_ERR
bool "Error"
help
	"Logs error and highier priority messages"

config DFN_VERB_WARN
bool "Warning"
help
	"Logs warning and highier priority messages"

config DFN_VERB_NOTICE
bool "Notice"
help
	"Logs notice and highier priority messages"

config DFN_VERB_INFO
bool "Info"
help
	"Logs informational and highier priority messages"

config DFN_VERB_DEBUG
bool "Debug"
help
	"Logs debug and highier priority messages"
endchoice
```

## resources/filter/filter/KConfig
```kconfig
config FILTER_>>>FILTER_UNAME<<<    
    bool ">>>FILTER_NAME<<< filter"
	default n
	>>>SELECT_PARENT<<<
```

## src/dump/KConfig
```kconfig
menu "Data dump"

config DFN_DUMP_APPEND
	bool "Append"
	default y
	depends on !DFN_DUMP_TYPE_NONE
	help
		"If previous session filter tree, database path, and name is idendical to current, then new filtered packets will be appeded to existing database. Otherwise action will be desided by \"Override\" option."

config DFN_DUMP_OVERRIDE
	bool "Override"
	depends on !DFN_DUMP_TYPE_NONE
	help
		"If checked, overrides old dump. Otherwise adds integer suffix to name."

choice
    prompt "Dump type"
    default DFN_DUMP_SQLITE3

config DFN_DUMP_TYPE_SQLITE3
	bool "Sqlite3 DB"
	help
		"Dumps filtered packets to autogenerated sqlite3 database."
  
config DFN_DUMP_TYPE_MYSQL
	bool "MySql DB"
	help
		"Dumps filtered packets to autogenerated MySQL database."

config DFN_DUMP_TYPE_PQ
	bool "PostgreSql DB"
	help
		"Dumps filtered packets to autogenerated Postgre database."

config DFN_DUMP_TYPE_NONE
	bool "None"
	help
		"Does not save filtered packets"

endchoice

config DFN_DUMP_SQLITE3_PATH
	string "Dump path"
	default "./"
	depends on DFN_DUMP_TYPE_SQLITE3
	help
		"Path where database will be dumped."

config DFN_DUMP_SQLITE3_DB
	string "Database name"
	default "dump"
	depends on DFN_DUMP_TYPE_SQLITE3
	help
		"Path where database will be dumped."


config DFN_DUMP_MYSQL_HOST
	string "Host"
	default "localhost"
	depends on DFN_DUMP_TYPE_MYSQL
	help
		"URL where database is hosted."

config DFN_DUMP_MYSQL_PORT
	int "Port"
	default 3306
	depends on DFN_DUMP_TYPE_MYSQL
	help
		"MySQL server port."

config DFN_DUMP_MYSQL_USER
	string "User"
	default "root"
	depends on DFN_DUMP_TYPE_MYSQL
	help
		"User with permissions to create and delete databases."

config DFN_DUMP_MYSQL_PASS
	string "Password"
	default "root"
	depends on DFN_DUMP_TYPE_MYSQL
	help
		"Password for user mentioned above."

config DFN_DUMP_MYSQL_DB
	string "Database name"
	default "dump"
	depends on DFN_DUMP_TYPE_MYSQL
	help
		"Database name where filtered data will be dumped."

config DFN_DUMP_PQ_HOST
	string "Host"
	default "localhost"
	depends on DFN_DUMP_TYPE_PQ
	help
		"URL where database is hosted."

config DFN_DUMP_PQ_PORT
	int "Port"
	default 5432
	depends on DFN_DUMP_TYPE_PQ
	help
		"MySQL server port."

config DFN_DUMP_PQ_USER
	string "User"
	default "postgres"
	depends on DFN_DUMP_TYPE_PQ
	help
		"User with permissions to create and delete databases."

config DFN_DUMP_PQ_PASS
	string "Password"
	default ""
	depends on DFN_DUMP_TYPE_PQ
	help
		"Password for user mentioned above."

config DFN_DUMP_PQ_DB
	string "Database name"
	default "dump"
	depends on DFN_DUMP_TYPE_PQ
	help
		"Database name where filtered data will be dumped."

endmenu
```

## src/filters/KConfig
```kconfig
menu "Filters"

source "src/filters/arp/KConfig"
source "src/filters/ethernet/KConfig"
source "src/filters/icmpv4/KConfig"
source "src/filters/icmpv6/KConfig"
source "src/filters/igmp/KConfig"
source "src/filters/ipv4/KConfig"
source "src/filters/ipv6/KConfig"
source "src/filters/tcp/KConfig"
source "src/filters/udp/KConfig"

endmenu
```

## src/filters/icmpv4/KConfig
```kconfig
config FILTER_ICMPV4    
    bool "icmpv4 filter"
	default n
	select FILTER_IPV4
```

## src/filters/icmpv6/KConfig
```kconfig
config FILTER_ICMPV6    
    bool "icmpv6 filter"
	default n
	select FILTER_IPV6
```

## src/filters/ipv4/KConfig
```kconfig
config FILTER_IPV4    
    bool "ipv4 filter"
	default n
	select FILTER_ETHERNET
```

## src/filters/ipv6/KConfig
```kconfig
config FILTER_IPV6    
    bool "ipv6 filter"
	default n
	select FILTER_ETHERNET
```

## tests/KConfig
```kconfig
menu "Tests"

config TEST_CMOCKA
bool "Cmocka unit tests"
default y
help
	Run unit tests written using Cmocka library


config TEST_IMPROV
bool "Integration tests"
default y
help
	Run impovized integration tests. This uses inout file and capture statistics features to test proogram correctness

endmenu
```
